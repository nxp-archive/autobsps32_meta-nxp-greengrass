## conf/layer.conf
```bitbake
# We have a conf and classes directory, add to BBPATH
BBPATH .= ":${LAYERDIR}"

# We have recipes-* directories, add to BBFILES
BBFILES += "${LAYERDIR}/recipes-*/*/*.bb \
	${LAYERDIR}/recipes-*/*/*.bbappend"

BBFILE_COLLECTIONS += "nxp-greengrass"
BBFILE_PATTERN_nxp-greengrass = "^${LAYERDIR}/"
BBFILE_PRIORITY_nxp-greengrass = "16"

# Additional license directories.
LICENSE_PATH += "${LAYERDIR}/custom-licenses"
LAYERSERIES_COMPAT_nxp-greengrass = "zeus gatesgarth"
```
